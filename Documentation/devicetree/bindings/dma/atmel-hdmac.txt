## Documentation/devicetree/bindings/dma/atmel-hdmac.txt
```
* Atmel Direct Memory Access Controller (DMA)

Required properties:
- compatible: Should be "atmel,<chip>-hdmac"
- reg: Should contain DMA registers location and length
- interrupts: Should contain DMA interrupt
- atmel,hdmac-nr-channels: Should contain number of channels
  available in the controller

Optional properties:
- atmel,hdmac-cap-memcpy: Chip can do memory to memory transfers
- atmel,hdmac-cap-slave: Chip can do peripherals/memory transfers

Examples:

dma@ffffec00 {
	compatible = "atmel,at91sam9g45-hdmac";
	reg = <0xffffec00 0x200>;
	interrupts = <21>;
	atmel,hdmac-nr-channels = <8>;
	atmel,hdmac-cap-memcpy;
	atmel,hdmac-cap-slave;
};
```

## Documentation/devicetree/bindings/eeprom.txt
```
EEPROMs (I2C)

Required properties:

  - compatible : should be "<manufacturer>,<type>"
		 If there is no specific driver for <manufacturer>, a generic
		 driver based on <type> is selected. Possible types are:
		 24c00, 24c01, 24c02, 24c04, 24c08, 24c16, 24c32, 24c64,
		 24c128, 24c256, 24c512, 24c1024, spd

  - reg : the I2C address of the EEPROM

Optional properties:

  - pagesize : the length of the pagesize for writing. Please consult the
               manual of your device, that value varies a lot. A wrong value
	       may result in data loss! If not specified, a safety value of
	       '1' is used which will be very slow.

  - read-only: this parameterless property disables writes to the eeprom

Example:

eeprom@52 {
	compatible = "atmel,24c32";
	reg = <0x52>;
	pagesize = <32>;
};

EEPROMs (SPI)

Required properties:

- compatible : should be "at25"
- reg : should specify SPI address (chip-select number).
- spi-max-frequency : maximum frequency for this device (Hz).
- addr: addressing 8/16/24 bit
- size: the length of the eeprom
- pagesize: the length of the pagesize

Example:

eeprom@0 {
	compatible = "at25";
	reg = <0>;
	spi-max-frequency = <1000000>;
	addr = <8>;
	size = <8192>;
	pagesize = <32>;
};
```

## Documentation/devicetree/bindings/gpio/gpio_i2c.txt
```
Device-Tree bindings for i2c gpio driver

Required properties:
	- compatible = "i2c-gpio";
	- gpios: sda and scl gpio


Optional properties:
	- i2c-gpio,sda-open-drain: sda as open drain
	- i2c-gpio,scl-open-drain: scl as open drain
	- i2c-gpio,scl-output-only: scl as output only
	- udelay: delay between GPIO operations (may depend on each platform)
	- timeout: timeout to get data (ms)

Example nodes:

i2c-gpio@0 {
	compatible = "i2c-gpio";
	gpios = <&pioA 23 0 /* sda */
		 &pioA 24 0 /* scl */
		>;
	i2c-gpio,sda-open-drain;
	i2c-gpio,scl-open-drain;
	udelay = <2>;		/* ~100 kHz */
	#address-cells = <1>;
	#size-cells = <0>;

	rv3029c2@56 {
		compatible = "rv3029c2";
		reg = <0x56>;
	};
};
```

## Documentation/devicetree/bindings/misc/atmel-ssc.txt
```
* Atmel SSC

Required properties:
- compatible: Should be "atmel,at91rm9200-ssc"
- reg: Should contain SSC registers location and length
- interrupts : Should contain SSC interrupt

Examples:

ssc0: scc@fffbc000 {
	compatible = "atmel,at91rm9200-ssc";
	reg = <0xfffbc000 0x4000>;
	interrupts = <14 4>;
};
```

## Documentation/devicetree/bindings/mtd/atmel-nand.txt
```
Atmel NAND flash

Required properties:
- compatible : "atmel,at91rm9200-nand".
- reg : should specify localbus address and size used for the chip,
	and if availlable the ECC.
- atmel,nand-addr-offset : offset for the address latch.
- atmel,nand-cmd-offset : offset for the command latch.
- #address-cells, #size-cells : Must be present if the device has sub-nodes
  representing partitions.

- gpios : specifies the gpio pins to control the NAND device. detect is an
  optional gpio and may be set to 0 if not present.

Optional properties:
- bank-width : Width (in bytes) of the device.  If not present, the width
  defaults to 1 byte.

Examples:
nand0: nand@40000000,0 {
	compatible = "atmel,at91rm9200-nand";
	#address-cells = <1>;
	#size-cells = <1>;
	reg = <0x40000000 0x10000000
	       0xffffe800 0x200
	      >;
	atmel,nand-addr-offset = <21>;
	atmel,nand-cmd-offset = <22>;
	gpios = <&pioC 13 0
		 &pioC 14 0
		 0
		>;
	partition@0 {
		...
	};
};
```

## Documentation/devicetree/bindings/spi/spi_atmel.txt
```
Atmel SPI device

Required properties:
- compatible : should be "atmel,at91rm9200-spi".
- reg: Address and length of the register set for the device
- interrupts: Should contain macb interrupt
```

## Documentation/devicetree/bindings/usb/at91_udc.txt
```
Atmel AT91 USB device controller

Required properties:
 - compatible: Should be "atmel,at91rm9200-udc"
 - reg: Address and length of the register set for the device
 - interrupts: Should contain macb interrupt

Optional properties:
 - atmel,vbus-gpio: If present, specifies a gpio that needs to be
   activated for the bus to be powered.

usb1: gadget@fffa4000 {
	compatible = "atmel,at91rm9200-udc";
	reg = <0xfffa4000 0x4000>;
	interrupts = <10 4>;
	atmel,vbus-gpio = <&pioC 5 0>;
};
```

## Documentation/devicetree/bindings/watchdog/atmel-wdt.txt
```
* Atmel Watchdog Timer (WDT) Controller

Required properties:
- compatible : Should be "atmel,at91sam9260-wdt"
- reg : Should contain WDT registers location and length

Examples:

wdt@fffffd40 {
	compatible = "atmel,at91sam9260-wdt";
	reg = <0xfffffd40 0x10>;
};
```
